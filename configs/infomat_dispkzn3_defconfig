## configs/infomat_dispkzn3_defconfig
```kconfig
BR2_arm=y
BR2_cortex_a7=y
BR2_ARM_FPU_VFPV4=y
BR2_GLOBAL_PATCH_DIR="board/infomat/dispkzn3/patches"
BR2_PACKAGE_HOST_LINUX_HEADERS_CUSTOM_6_18=y
# BR2_DOWNLOAD_FORCE_CHECK_HASHES=y
BR2_TARGET_GENERIC_HOSTNAME="infomat-dispkzn3"
BR2_TARGET_GENERIC_ISSUE="Infomatika"
BR2_ROOTFS_DEVICE_CREATION_DYNAMIC_EUDEV=y
BR2_TARGET_GENERIC_GETTY_PORT="ttyS1"
BR2_SYSTEM_DHCP="eth0"
BR2_ROOTFS_OVERLAY="board/infomat/dispkzn3/rootfs_overlay"
BR2_ROOTFS_POST_IMAGE_SCRIPT="support/scripts/genimage.sh"
BR2_ROOTFS_POST_SCRIPT_ARGS="-c board/infomat/dispkzn3/genimage.cfg"
BR2_LINUX_KERNEL=y
BR2_LINUX_KERNEL_CUSTOM_VERSION=y
BR2_LINUX_KERNEL_CUSTOM_VERSION_VALUE="6.18.44"
BR2_LINUX_KERNEL_DEFCONFIG="sunxi"
BR2_LINUX_KERNEL_DTS_SUPPORT=y
BR2_LINUX_KERNEL_INTREE_DTS_NAME="allwinner/sun8i-t113s-infomat-dispkzn3"
BR2_LINUX_KERNEL_INSTALL_TARGET=y
BR2_LINUX_KERNEL_NEEDS_HOST_OPENSSL=y
BR2_TARGET_ROOTFS_EXT2=y
BR2_TARGET_ROOTFS_EXT2_4=y
# BR2_TARGET_ROOTFS_TAR is not set
BR2_TARGET_UBOOT=y
BR2_TARGET_UBOOT_CUSTOM_VERSION=y
BR2_TARGET_UBOOT_CUSTOM_VERSION_VALUE="2026.07"
BR2_TARGET_UBOOT_BUILD_SYSTEM_KCONFIG=y
BR2_TARGET_UBOOT_PATCH=""
BR2_TARGET_UBOOT_USE_DEFCONFIG=y
BR2_TARGET_UBOOT_BOARD_DEFCONFIG="infomat_dispkzn3"
BR2_TARGET_UBOOT_NEEDS_DTC=y
BR2_TARGET_UBOOT_NEEDS_PYLIBFDT=y
BR2_TARGET_UBOOT_NEEDS_OPENSSL=y
BR2_TARGET_UBOOT_NEEDS_GNUTLS=y
BR2_TARGET_UBOOT_SPL=y
BR2_TARGET_UBOOT_SPL_NAME="u-boot-sunxi-with-spl.bin"
BR2_PACKAGE_HOST_GENIMAGE=y
BR2_PACKAGE_HOST_DOSFSTOOLS=y
BR2_PACKAGE_HOST_MTOOLS=y
BR2_PACKAGE_HOST_UBOOT_TOOLS=y
BR2_PACKAGE_HOST_UBOOT_TOOLS_BOOT_SCRIPT=y
BR2_PACKAGE_HOST_UBOOT_TOOLS_BOOT_SCRIPT_SOURCE="board/infomat/dispkzn3/boot.cmd"
```

## package/fbvnc/Config.in
```kconfig
config BR2_PACKAGE_FBVNC
	bool "fbvnc"
	help
	  A small VNC client for Linux framebuffer.

	  Fbvnc is a small VNC client for Linux framebuffer. Without
	  arguments, it connects to port 5900 of 127.0.0.1. Once
	  connected, it sends keyboard and mouse inputs to the VNC
	  server and updates the screen when necessary.

	  https://github.com/lightelf76/fbvnc
```

## package/freerdp3/Config.in
```kconfig
config BR2_PACKAGE_FREERDP3
    bool "freerdp3"
    depends on BR2_INSTALL_LIBSTDCPP
    depends on BR2_USE_WCHAR
    depends on BR2_TOOLCHAIN_HAS_THREADS
    depends on BR2_USE_MMU
    depends on BR2_TOOLCHAIN_HAS_SYNC_4
    select BR2_PACKAGE_OPENSSL
    select BR2_PACKAGE_ZLIB
    select BR2_PACKAGE_LIBGLIB2
    select BR2_PACKAGE_SDL2
    select BR2_PACKAGE_SDL2_KMSDRM      # çàñòàâèò ñîáðàòü SDL2 ñ KMS/DRM
    select BR2_PACKAGE_LIBDRM
    help
      FreeRDP3 client with SDL2/KMSDRM output (software rendering).
```

## package/libva-v4l2/Config.in
```kconfig
config BR2_PACKAGE_LIBVA_V4L2
	bool "libva-v4l2-driver"
	depends on BR2_INSTALL_LIBSTDCPP
	depends on BR2_TOOLCHAIN_HAS_THREADS
	depends on !BR2_STATIC_LIBS
	depends on BR2_PACKAGE_HAS_LIBUDEV
	select BR2_PACKAGE_LIBVA
	select BR2_PACKAGE_LIBDRM
	help
	  V4L2 libVA backend for stateless video codecs.
	  https://github.com/mxsrc/libva-v4l2
```
